## arch/arm/cpu/arm926ejs/mxs/Kconfig
```kconfig
config MXS
	bool
	select CPU_ARM926EJS
	select SUPPORT_SPL

if MXS

config SYS_SOC
	default "mxs"

config MXSIMAGE_WITH_ZIMAGE
	bool "Include zImage into bootstream (u-boot.sb)"
	default no

config SPL_MXS_PWR_NOBAT
	bool "Device without battery"
	default y

config SPL_MXS_BATT_NO_4P2
	bool "Do not enable 4P2 regulator on battery (BAT) power"
	default n

config SPL_MXS_DDR_LOWPWR
	bool "DDR low power mode"
	default n
	help
	  Enable this for Alliance memory

choice
	prompt "DDR CAS latency"
	default SPL_MXS_DDR_CL25

config SPL_MXS_DDR_CL2
	bool "2"

config SPL_MXS_DDR_CL25
	bool "2.5"

config SPL_MXS_DDR_CL3
	bool "3"

endchoice

endif
```

## board/contactless/mx23_wirenboard/Kconfig
```kconfig
if TARGET_MX23_WIRENBOARD

config SYS_BOARD
	default "mx23_wirenboard"

config SYS_VENDOR
	default "contactless"

config SYS_CONFIG_NAME
	default "mx23_wirenboard"

endif
```

## board/contactless/mx28_wirenboard/Kconfig
```kconfig
if TARGET_MX28_WIRENBOARD

config SYS_BOARD
	default "mx28_wirenboard"

config SYS_VENDOR
	default "contactless"

config SYS_CONFIG_NAME
	default "mx28_wirenboard"

config BOOT_USBGADGET
	bool "Boot as Linux USB Mass Storage Gadget"
	default no

endif
```

## configs/mx23_wirenboard_defconfig
```kconfig
CONFIG_ARM=y
CONFIG_TARGET_MX23_WIRENBOARD=y
# CONFIG_SYS_MALLOC_F is not set
CONFIG_SPL=y
CONFIG_FIT=y
CONFIG_FIT_SIGNATURE=y
# CONFIG_CMD_IMLS is not set
# CONFIG_CMD_FLASH is not set
# CONFIG_CMD_SETEXPR is not set
CONFIG_DM=y
CONFIG_SYS_EXTRA_OPTIONS="SPL_MXS_DDR_LOWPWR SPL_MXS_DDR_CL25"
```

## configs/mx28_wirenboard5_defconfig
```kconfig
CONFIG_ARM=y
CONFIG_TARGET_MX28_WIRENBOARD=y
CONFIG_SPL=y
CONFIG_SPL_MXS_PWR_NOBAT=n
CONFIG_SPL_MXS_BATT_NO_4P2=y
CONFIG_SYS_EXTRA_OPTIONS="ENV_IS_IN_MMC "
# CONFIG_CMD_IMLS is not set
# CONFIG_CMD_FLASH is not set
CONFIG_SPI_FLASH=y
```

## configs/mx28_wirenboard5_usbgadget_defconfig
```kconfig
CONFIG_ARM=y
CONFIG_TARGET_MX28_WIRENBOARD=y
CONFIG_MXSIMAGE_WITH_ZIMAGE=y
CONFIG_BOOT_USBGADGET=y
CONFIG_SPL=y
CONFIG_SPL_MXS_PWR_NOBAT=n
CONFIG_SPL_MXS_BATT_NO_4P2=y
CONFIG_SYS_EXTRA_OPTIONS="ENV_IS_NOWHERE"
# CONFIG_CMD_IMLS is not set
# CONFIG_CMD_FLASH is not set
CONFIG_SPI_FLASH=y
```

## configs/mx6ul_wirenboard6_defconfig
```kconfig
CONFIG_ARM=y
CONFIG_ARCH_MX6=y
CONFIG_SPL_GPIO_SUPPORT=y
CONFIG_SPL_LIBCOMMON_SUPPORT=y
CONFIG_SPL_LIBGENERIC_SUPPORT=y
CONFIG_TARGET_MX6UL_WIRENBOARD=y
CONFIG_SPL_EXT_SUPPORT=y
CONFIG_SPL_I2C_SUPPORT=y
CONFIG_SPL_LIBDISK_SUPPORT=y
CONFIG_SPL_MMC_SUPPORT=y
CONFIG_SPL_SERIAL_SUPPORT=y
CONFIG_SPL_WATCHDOG_SUPPORT=y
CONFIG_FIT=y
CONFIG_FIT_SIGNATURE=y
CONFIG_SYS_EXTRA_OPTIONS="IMX_CONFIG=board/contactless/mx6ul_wirenboard/imximage.cfg"
CONFIG_BOOTDELAY=3
CONFIG_SYS_CONSOLE_IS_IN_ENV=y
CONFIG_SPL=y
CONFIG_HUSH_PARSER=y
CONFIG_CMD_BOOTZ=y
# CONFIG_CMD_IMLS is not set
CONFIG_CMD_MEMTEST=y
# CONFIG_CMD_LOADB is not set
# CONFIG_CMD_LOADS is not set
# CONFIG_CMD_FLASH is not set
CONFIG_CMD_MMC=y
CONFIG_CMD_USB=y
# CONFIG_CMD_FPGA is not set
CONFIG_CMD_GPIO=y
CONFIG_CMD_DHCP=y
# CONFIG_CMD_NFS is not set
CONFIG_CMD_PING=y
CONFIG_CMD_CACHE=y
CONFIG_CMD_EXT4=y
CONFIG_CMD_FAT=y
CONFIG_CMD_FS_GENERIC=y
CONFIG_USB=y
CONFIG_USB_STORAGE=y
CONFIG_OF_LIBFDT=y
# CONFIG_EFI_LOADER is not set
```

## configs/wirenboard8_defconfig
```kconfig
CONFIG_ARM=y
CONFIG_ARM_SMCCC=y
CONFIG_ARCH_SUNXI=y
CONFIG_DEFAULT_DEVICE_TREE="sun50i-h616-wirenboard8xx"
CONFIG_SPL=y
CONFIG_BOOTSTAGE_STASH_ADDR=0
CONFIG_DRAM_SUN50I_H616_DX_ODT=0x07070707
CONFIG_DRAM_SUN50I_H616_DX_DRI=0x0e0e0e0e
CONFIG_DRAM_SUN50I_H616_CA_DRI=0x0e0e
CONFIG_DRAM_SUN50I_H616_ODT_EN=0x7887bbbb
CONFIG_DRAM_SUN50I_H616_TPR6=0x4C808080
CONFIG_DRAM_SUN50I_H616_TPR10=0x402f6633
CONFIG_DRAM_SUN50I_H616_TPR11=0x1c20201d
CONFIG_DRAM_SUN50I_H616_TPR12=0x090a0a0a
CONFIG_DRAM_SUN50I_H616_TPR13=0x60
CONFIG_DRAM_SUN50I_H616_MR3=0x33
CONFIG_DRAM_SUN50I_H616_MR11=0x4
CONFIG_DRAM_SUN50I_H616_MR12=0x72
CONFIG_DRAM_SUN50I_H616_MR14=0x9
CONFIG_DRAM_SUN50I_H616_MR22=0x24
CONFIG_MACH_SUN50I_H616=y
CONFIG_SUNXI_DRAM_T507_LPDDR4=y
CONFIG_DRAM_CLK=780
CONFIG_MMC_SUNXI_SLOT_EXTRA=2
CONFIG_R_I2C_ENABLE=y
# CONFIG_PSCI_RESET is not set
# CONFIG_SYS_MALLOC_CLEAR_ON_INIT is not set
# CONFIG_AUTOBOOT is not set
CONFIG_LOGLEVEL=9
CONFIG_SYS_DEVICE_NULLDEV=y
CONFIG_SPL_I2C=y
# CONFIG_SYS_MMCSD_FS_BOOT is not set
CONFIG_ENV_IS_NOWHERE=y
# CONFIG_ENV_IS_IN_FAT is not set
CONFIG_ENV_IS_IN_MMC=y
CONFIG_SYS_MMC_ENV_DEV=2
CONFIG_SPL_SYS_I2C_LEGACY=y
CONFIG_SYS_I2C_MVTWSI=y
CONFIG_SYS_I2C_SLAVE=0x36
CONFIG_REGULATOR_AXP=y
# CONFIG_DM_REGULATOR_FIXED is not set
CONFIG_AXP15060_POWER=y
CONFIG_AXP_DCDC1_VOLT=3300
CONFIG_AXP_DCDC2_VOLT=900
CONFIG_AXP_DCDC3_VOLT=940
CONFIG_AXP_DCDC4_VOLT=900
CONFIG_AXP_DCDC5_VOLT=1100
CONFIG_AXP_ALDO1_VOLT=1800
CONFIG_AXP_ALDO2_VOLT=1800
CONFIG_AXP_ALDO3_VOLT=0
CONFIG_AXP_ALDO4_VOLT=1800
CONFIG_AXP_SW_ON=y
# CONFIG_EFI_LOADER is not set
```
